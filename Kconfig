## Kconfig
```kconfig
# Sensor data simulator
#
# Copyright (c) 2019 Nordic Semiconductor
#
# SPDX-License-Identifier: LicenseRef-Nordic-5-Clause
#

menuconfig PMW3320
    bool "PMW3320 mouse optical sensor"
  select SPI
    help
      Enable PMW3320 mouse optical sensor.

if PMW3320

config PMW3320_CPI
    int "PMW3320's default CPI"
    default 800
    range 200 3200
    help
      Default CPI value, with 200 step

config PMW3320_CPI_DIVIDOR
    int "PMW3320's default CPI dividor"
    default 1
    range 1 100
    help
      Default CPI dividor value.

config PMW3320_SNIPE_CPI
    int "PMW3320's CPI in snipe mode"
    default 200
    range 200 3200
    help
      Snipe CPI value, with 200 step

config PMW3320_SNIPE_CPI_DIVIDOR
    int "PMW3320's CPI dividor in snipe mode"
    default 1
    range 1 100
    help
      Snipe CPI dividor value.

config PMW3320_SCROLL_TICK
    int "PMW3320's required ticks to produce a scroll report"
    default 20
    help
      Scroll tick value.

choice
    prompt "Select PMW3320's polling rate"
    default PMW3320_POLLING_RATE_250

config PMW3320_POLLING_RATE_250
    bool "250 Hz"

config PMW3320_POLLING_RATE_125
    bool "125 Hz"

config PMW3320_POLLING_RATE_125_SW
    bool "125 Hz with software implementation"

endchoice

config PMW3320_FORCE_AWAKE
    bool "PMW3320 forced awake mode"
    help
      This setting forces the sensor to always be in the RUN state.

config PMW3320_RUN_DOWNSHIFT_TIME_MS
    int "PMW3320's default RUN mode downshift time"
    default 128
    range 13 3264
    help
      Default RUN mode downshift down time in milliseconds.
      Time after which sensor goes from RUN to REST1 mode.

config PMW3320_REST1_SAMPLE_TIME_MS
    int "PMW3320's sample time in REST1 stage"
    default 40
    range 10 2550
    help
      Default REST1 mode sample period in millisecond

config PMW3320_REST1_DOWNSHIFT_TIME_MS
    int "PMW3320's default REST1 mode downshift time"
    default 9600
    help
      Default REST1 mode downshift down time in milliseconds.
      Time after which sensor goes from REST1 to REST2 mode.

config PMW3320_REST2_SAMPLE_TIME_MS
    int "PMW3320's sample time in REST2 stage"
    default 0
    range 0 2550
    help
      Default REST2 mode sample period in millisecond.
      Minimum value is 10.
      No optimal value provided by datasheet.

config PMW3320_REST2_DOWNSHIFT_TIME_MS
    int "PMW3320's default REST2 mode downshift time"
    default 0
    help
      Default REST2 mode downshift down time in milliseconds.
      Time after which sensor goes from REST2 to REST3 mode.
      No optimal value provided by datasheet.

config PMW3320_REST3_SAMPLE_TIME_MS
    int "PMW3320's sample time in REST3 stage"
    default 0
    range 0 2550
    help
      Default REST2 mode sample period in millisecond.
      Minimum value is 10.
      No optimal value provided by datasheet.

choice
    prompt "Select PMW3320 sensor orientation"
    default PMW3320_ORIENTATION_0

config PMW3320_ORIENTATION_0
    bool "PMW3320 not rotated"

config PMW3320_ORIENTATION_90
    bool "PMW3320 rotated 90 deg clockwise"

config PMW3320_ORIENTATION_180
    bool "PMW3320 rotated 180 deg clockwise"

config PMW3320_ORIENTATION_270
    bool "PMW3320 rotated 270 deg clockwise"

endchoice

config PMW3320_INVERT_X
  bool "Invert the X axis of PMW3320 sensor"

config PMW3320_INVERT_Y
  bool "Invert the Y axis of PMW3320 sensor"

config PMW3320_AUTOMOUSE_TIMEOUT_MS
  int "Amount of milliseconds the mouse layer will be active after using the trackball"
  default 400

module = PMW3320
module-str = PMW3320
source "${ZEPHYR_BASE}/subsys/logging/Kconfig.template.log_config"

endif #PMW3320
```

## dts/bindings/pixart,pmw3320.yml
```yaml
description: |
  Sensor driver for the pixart PMW3320 mouse sensor 

compatible: "pixart,pmw3320"

include: spi-device.yaml

properties:
  irq-gpios:
    type: phandle-array
    required: true
  scroll-layers:
    type: array
    default: []
  snipe-layers:
    type: array
    default: []
  automouse-layer:
    type: int
    default: -1
```
